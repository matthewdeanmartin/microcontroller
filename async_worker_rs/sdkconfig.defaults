## async_worker_rs/sdkconfig.defaults
```kconfig
CONFIG_IDF_TARGET="esp32s2"
CONFIG_ESPTOOLPY_FLASHSIZE_4MB=y
CONFIG_ESPTOOLPY_FLASHMODE_DIO=y
CONFIG_PARTITION_TABLE_SINGLE_APP_LARGE=y
CONFIG_FREERTOS_UNICORE=y
CONFIG_ESP_MAIN_TASK_STACK_SIZE=16384
CONFIG_ESP_CONSOLE_USB_CDC=y
CONFIG_ESP_CONSOLE_UART_DEFAULT=n
CONFIG_HTTPD_MAX_REQ_HDR_LEN=1024
CONFIG_HTTPD_MAX_URI_LEN=128
CONFIG_LWIP_MAX_SOCKETS=10
```

## hello_wifi/main/Kconfig.projbuild
```kconfig
menu "Hello WiFi"

    config HELLO_WIFI_SSID
        string "WiFi SSID"
        default "myssid"
        help
            Name of your 2.4GHz WiFi network. The ESP32-S2 has no 5GHz radio.

    config HELLO_WIFI_PASSWORD
        string "WiFi password"
        default "mypassword"
        help
            WPA2 password. Leave blank for an open network.

endmenu
```

## screen_info/sdkconfig.defaults
```kconfig
CONFIG_IDF_TARGET="esp32c6"
CONFIG_ESPTOOLPY_FLASHSIZE_8MB=y
CONFIG_PARTITION_TABLE_CUSTOM=y
CONFIG_PARTITION_TABLE_CUSTOM_FILENAME="partitions.csv"
CONFIG_ESP_CONSOLE_USB_SERIAL_JTAG=y
CONFIG_ESP_DEFAULT_CPU_FREQ_MHZ_160=y
CONFIG_FREERTOS_HZ=100
CONFIG_ESP_MAIN_TASK_STACK_SIZE=8192
CONFIG_LWIP_LOCAL_HOSTNAME="waveshare-c6"
```
